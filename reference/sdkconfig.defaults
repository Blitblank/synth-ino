## reference/sdkconfig.defaults
```kconfig
CONFIG_HTTPD_WS_SUPPORT=y

CONFIG_ESP_CONSOLE_USB_CDC=y

CONFIG_ESP_CONSOLE_UART_DEFAULT=n
CONFIG_ESP_CONSOLE_UART=n
CONFIG_CONSOLE_UART_DEFAULT=n
CONFIG_CONSOLE_UART=n
```
